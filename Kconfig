## Kconfig
```kconfig
source "$APPSDIR/ara/nklabs/lab1/Kconfig"
source "$APPSDIR/ara/nklabs/lab2/Kconfig"
source "$APPSDIR/ara/nklabs/lab3/Kconfig"
```

## lab3/Kconfig
```kconfig
config NKLABS_LAB3
	bool "Lab3"
	default n
	---help---
		Enable Lab1

if NKLABS_LAB3

config NKLABS_LAB3_PROGNAME
	string "Program name"
	default "NK Labs"
	depends on BUILD_KERNEL
	---help---
		This is the name of the program that will be use when the NSH ELF
		program is installed.

endif
```

## nklabs/lab1/Kconfig
```kconfig
config NKLABS_LAB1
	bool "Lab1"
	default n
	---help---
		Enable Lab1

if NKLABS_LAB1

config NKLABS_LAB1_PROGNAME
	string "Program name"
	default "NK Labs"
	depends on BUILD_KERNEL
	---help---
		This is the name of the program that will be use when the NSH ELF
		program is installed.

endif
```

## nklabs/lab2/Kconfig
```kconfig
config NKLABS_LAB2
	bool "Lab2"
	default n
	---help---
		Enable Lab1

if NKLABS_LAB2

config NKLABS_LAB2_PROGNAME
	string "Program name"
	default "NK Labs"
	depends on BUILD_KERNEL
	---help---
		This is the name of the program that will be use when the NSH ELF
		program is installed.

endif
```
